## conf/layer.conf
```bitbake
# We have a conf and classes directory, add to BBPATH
BBPATH .= ":${LAYERDIR}"

# We have recipes-* directories, add to BBFILES
BBFILES += "${LAYERDIR}/recipes-*/*/*.bb \
            ${LAYERDIR}/recipes-*/*/*.bbappend"

BBFILE_COLLECTIONS += "meta-yocto-live"
BBFILE_PATTERN_meta-yocto-live = "^${LAYERDIR}/"
BBFILE_PRIORITY_meta-yocto-live = "6"

LAYERDEPENDS_meta-yocto-live = "core"
LAYERSERIES_COMPAT_meta-yocto-live = "thud"
```
